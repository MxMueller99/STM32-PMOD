/*
 * ssd1306.c
 *
 *  Created on: Jul 23, 2025
 *      Author: max
 */


#include "ssd1306.h"
#include <string.h>             // For memset

#define SSD1306_ADDR  (0x3C << 1)
#define CMD           0x00
#define DATA          0x40

static I2C_HandleTypeDef *i2c;
static uint8_t framebuffer[128 * 4];

// Helper Functions
static void wr_cmd(uint8_t c) {
    HAL_I2C_Mem_Write(i2c, SSD1306_ADDR, CMD, I2C_MEMADD_SIZE_8BIT, &c, 1, HAL_MAX_DELAY);
}

static void wr_data(uint8_t *bytes, uint16_t len) {
    HAL_I2C_Mem_Write(i2c, SSD1306_ADDR, DATA, I2C_MEMADD_SIZE_8BIT, bytes, len, HAL_MAX_DELAY);
}

// Font declaration
static const uint8_t font6x8[] = {
		  0x00, 0x00, 0x00, 0x00, 0x00, 0x00, //   0
		  0x00, 0x00, 0x00, 0x2f, 0x00, 0x00, // ! 1
		  0x00, 0x00, 0x07, 0x00, 0x07, 0x00, // " 2
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		  0x00, 0x08, 0x04, 0x08, 0x10, 0x08, // ~ 94
};

// OLED Init CMDs
void ssd1306_init(I2C_HandleTypeDef *hi2c)
{
    i2c = hi2c;

    const uint8_t seq[] = {
        0xAE,             /* display off                     */
        0x20, 0x00,       /* horizontal addressing mode      */
        0xB0,             /* page 0                          */
        0xC8,             /* COM scan ↓                      */
        0x00, 0x10,       /* column = 0                      */
        0x40,             /* start line = 0                  */

        0x81, 0x7F,       /* contrast                        */
        0xA1,             /* segment remap = mirror X        */
        0xA6,             /* normal (not inverted)           */
        0xA8, 0x1F,       /* multiplex ratio 0x1F -> 32 rows */
        0xD3, 0x00,       /* display offset                  */

        0x8D, 0x14,       /* charge pump on                  */
        0xDA, 0x02,       /* COM pins = sequential           */
        0xD5, 0x80,       /* clock divide                    */
        0xD9, 0xF1,       /* pre-charge                      */
        0xDB, 0x40,       /* VCOMH deselect                  */

        0xA4,             /* entire display OFF              */
        0xAF              /* display ON                      */
    };
    HAL_I2C_Master_Transmit(i2c, SSD1306_ADDR, (uint8_t *)seq, sizeof seq, HAL_MAX_DELAY);

    ssd1306_fill(0x00);
    ssd1306_update();
}

void ssd1306_fill(uint8_t pattern) {
    memset(framebuffer, pattern, sizeof framebuffer);
}

void ssd1306_update(void) {
    for (uint8_t page = 0; page < 4; ++page) {
        wr_cmd(0xB0 | page);
        wr_cmd(0x00);
        wr_cmd(0x10);

        wr_data(&framebuffer[128 * page], 128);
    }
}

void ssd1306_draw_char(uint8_t x, uint8_t y, char c) {
    if (c < 32 || c > 127) c = '?';
    uint16_t idx = (c - 32) * 6;
    uint16_t fb_index = x + (y / 8) * 128;
    uint8_t  shift    = y & 7;

    for (uint8_t col = 0; col < 6; ++col) {
    	uint8_t line = font6x8[idx + col];

    	framebuffer[fb_index + col] |= line << shift;

    	if (shift && (fb_index + 128 < sizeof(framebuffer))) {
    		framebuffer[fb_index + col + 128] |= line >> (8 - shift);
    	}

    }
}

void ssd1306_draw_string(uint8_t x, uint8_t y, const char *s) {
    while (*s) {
        ssd1306_draw_char(x, y, *s++);
        x += 6;
        if (x > 122) break;
    }
}


